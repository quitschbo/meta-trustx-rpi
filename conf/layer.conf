## conf/layer.conf
```bitbake
BBPATH := "${BBPATH}:${LAYERDIR}"

BBFILES := "${BBFILES} ${LAYERDIR}/recipes-*/*/*.bb \
           ${LAYERDIR}/recipes-*/*/*.bbappend \
	   ${LAYERDIR}/images/*.bb*"


BBFILE_COLLECTIONS += "gyroidos-rpi"
BBFILE_PATTERN_gyroidos-rpi := "^${LAYERDIR}/"
BBFILE_PRIORITY_gyroidos-rpi := "8"

LAYERDEPENDS_gyroidos-rpi = "gyroidos-layer raspberrypi"

LAYERSERIES_COMPAT_gyroidos-rpi += "kirkstone"
```
